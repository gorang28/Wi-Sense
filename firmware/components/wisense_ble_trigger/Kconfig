## firmware/components/wisense_ble_trigger/Kconfig
```kconfig
menu "WiSense BLE Trigger (phone camera)"

    config WISENSE_BLE_TRIGGER_DEVICE_NAME
        string "BLE advertised device name"
        default "WiSense-RX"
        help
            Name the phone app (or a generic BLE scanner for testing before
            the app exists) looks for when connecting.

endmenu
```

## firmware/components/wisense_csi_infer/Kconfig
```kconfig
menu "WiSense CSI inference (TinyML)"
    visible if WISENSE_CLASSIFIER_TINYML

    comment "Defaults mirror python/live/live_cascade_detect.py; changing them"
    comment "here makes the device disagree with the PC pipeline."

    config WISENSE_CSI_RING_PACKETS
        int "CSI packets buffered for one feature window"
        default 256
        range 64 512
        help
            Must cover the whole feature window at the transmitter's packet
            rate: 2.0 s at 100 Hz needs 200. Costs 128 bytes each
            (32 subcarriers x float), so 256 packets is 32 KB of internal RAM.
            This buffer is also reused to hold the calibration samples.

    config WISENSE_CSI_EXPECTED_CHANNEL
        int "WiFi channel the transmitter uses"
        default 11
        range 1 14
        help
            Used only in the "no CSI packets" warning, to point at the most
            likely cause. Keep it equal to CONFIG_LESS_INTERFERENCE_CHANNEL in
            app_main.c and to the channel csi_send transmits on.

    config WISENSE_CSI_QUEUE_DEPTH
        int "CSI packets queued between the WiFi callback and inference"
        default 6
        range 2 32
        help
            Each slot holds one raw packet (~776 bytes). The queue never blocks
            the WiFi callback; a full queue drops the newest packet and counts
            it, matching how the binary stream's writer queue behaves.

    config WISENSE_CSI_WINDOW_MS
        int "Feature window (ms)"
        default 2000
        help
            Must equal window_2s_sec from preprocess_config.json. The trees were
            fitted on 2 s windows and mean nothing on a different span.

    config WISENSE_CSI_HOP_MS
        int "Minimum CSI time between predictions (ms)"
        default 250

    config WISENSE_CSI_MIN_COVERAGE_MILLI
        int "Required fraction of the window before predicting (x1000)"
        default 950
        range 500 1000
        help
            A rolling buffer capped at the window length normally sits one CSI
            period short of the exact boundary, because the oldest sample is
            evicted before the newest arrives. 950 accepts a nearly full window
            instead of waiting for an impossible exact span.

    config WISENSE_CSI_CALIBRATION_PACKETS
        int "Empty-room packets sampled for the baseline"
        default 1000
        range 0 20000
        help
            At ~100 Hz, 1000 packets is about 10 s. Only
            WISENSE_CSI_RING_PACKETS of them are retained, subsampled evenly
            across the whole period, which is ample for a median. 0 keeps the
            baseline the model was trained with and skips calibration.

    config WISENSE_CSI_GRACE_SEC
        int "Seconds to leave the room before calibration starts"
        default 15
        range 0 120
        help
            Calibrating the moment the board boots bakes whoever is standing
            next to it into the "empty" baseline, after which the room never
            reads EMPTY again.

    config WISENSE_CSI_SMOOTHING_MILLI
        int "EMA factor for stage probabilities (x1000)"
        default 400
        range 1 1000
        help
            1000 disables smoothing. Lower is steadier but slower to react.
            Single-window probabilities swing hard near a threshold, so
            averaging before thresholding is what removes EMPTY/PRESENCE
            flicker — debouncing the boolean alone only delays it.

    config WISENSE_CSI_OCCUPIED_CONSECUTIVE
        int "Consecutive windows required to enter OCCUPIED"
        default 2
        range 1 20

    config WISENSE_CSI_OCCUPIED_OFF_CONSECUTIVE
        int "Consecutive windows required to drop back to EMPTY"
        default 6
        range 1 40
        help
            Higher than the ON count on purpose. Recorded runs on this hardware
            flickered to EMPTY while someone sat very still at the symmetric
            value of 2, which is the Python default; 6 is the value that fixed
            it in live testing.

    config WISENSE_CSI_MOTION_CONSECUTIVE
        int "Consecutive windows required to flip PRESENCE<->MOTION"
        default 2
        range 1 20

    choice WISENSE_CSI_FALL_MODE
        prompt "Fall detection source"
        default WISENSE_CSI_FALL_MODE_RULE

        config WISENSE_CSI_FALL_MODE_RULE
            bool "Heuristic rule (motion burst then stillness)"
            help
                Keys off the occupied and motion stages, which have orders of
                magnitude more training data than the fall stage.

        config WISENSE_CSI_FALL_MODE_ML
            bool "Trained fall stage"
            help
                The fall stage scores held-out falls at 0.55 mean — it has ~127
                positive windows from ten recordings of a single fall at one
                spot and does not generalise. Not recommended.

        config WISENSE_CSI_FALL_MODE_OFF
            bool "Never report FALL"
    endchoice

    config WISENSE_CSI_FALL_MOTION_HIGH_MILLI
        int "Motion probability counting as the burst before a fall (x1000)"
        default 450
        depends on WISENSE_CSI_FALL_MODE_RULE

    config WISENSE_CSI_FALL_MOTION_LOW_MILLI
        int "Motion probability counting as stillness after a fall (x1000)"
        default 80
        depends on WISENSE_CSI_FALL_MODE_RULE

    config WISENSE_CSI_FALL_STILL_CONSECUTIVE
        int "Still windows required after the burst before FALL is declared"
        default 2
        range 1 20
        depends on WISENSE_CSI_FALL_MODE_RULE

    config WISENSE_CSI_FALL_LOOKBACK_MS
        int "How recently the motion burst must have happened (ms)"
        default 3000
        depends on WISENSE_CSI_FALL_MODE_RULE

    config WISENSE_CSI_FALL_HOLD_MS
        int "How long FALL is held once triggered (ms)"
        default 6000
        depends on WISENSE_CSI_FALL_MODE_RULE

    config WISENSE_CSI_FALL_CONSECUTIVE
        int "Consecutive fall-positive windows required for FALL"
        default 3
        range 1 20
        depends on WISENSE_CSI_FALL_MODE_ML

    config WISENSE_CSI_LOG_PREDICTIONS
        bool "Log every prediction"
        default y
        help
            One line per prediction, in the same shape as the PC tool's output,
            so device and PC runs can be compared directly. Turn off once the
            demo is stable to keep the console quiet.

    config WISENSE_CSI_SELFTEST
        bool "Verify the compiled model against the PC model at boot"
        default y
        help
            Scores vectors baked in by python/export/check_c_parity.py and logs
            PASS or FAIL. Cheap (a few milliseconds, once) and the only check
            that the exported tables and this firmware are still in step.

endmenu
```

## firmware/components/wisense_emergency/Kconfig
```kconfig
menu "WiSense Emergency (Fall + button)"

    config WISENSE_EMERGENCY_BUTTON_GPIO
        int "Cancel button GPIO"
        default 27
        help
            Push button input on RX. Default wiring: button to GND, GPIO with internal pull-up.

    choice WISENSE_EMERGENCY_BUTTON_ACTIVE_LEVEL
        prompt "GPIO level when button is pressed"
        default WISENSE_EMERGENCY_BUTTON_ACTIVE_LOW
        help
            Most momentary buttons tie GPIO to GND when pressed (active LOW).

        config WISENSE_EMERGENCY_BUTTON_ACTIVE_LOW
            bool "LOW = pressed"

        config WISENSE_EMERGENCY_BUTTON_ACTIVE_HIGH
            bool "HIGH = pressed"
    endchoice

    config WISENSE_EMERGENCY_COUNTDOWN_SEC
        int "Fall emergency countdown (seconds)"
        range 1 120
        default 15
        help
            Seconds shown on the OLED before notifying TX (ESP-NOW in a later module).

    config WISENSE_EMERGENCY_BUZZER_GPIO
        int "Buzzer GPIO"
        default 25
        help
            Active buzzer signal pin (HIGH or LOW turns tone ON per choice below).

    choice WISENSE_EMERGENCY_BUZZER_ON_LEVEL
        prompt "GPIO level that turns the buzzer ON"
        default WISENSE_EMERGENCY_BUZZER_ON_HIGH

        config WISENSE_EMERGENCY_BUZZER_ON_HIGH
            bool "HIGH = buzzer ON"

        config WISENSE_EMERGENCY_BUZZER_ON_LOW
            bool "LOW = buzzer ON"
    endchoice

    config WISENSE_EMERGENCY_BUZZER_PULSE_MS
        int "Fast beep pulse length (ms)"
        range 50 500
        default 120
        help
            ON time for each short beep during the countdown phase.

    config WISENSE_EMERGENCY_BUZZER_FAST_INTERVAL_MS
        int "Fast beep interval during countdown (ms)"
        range 100 2000
        default 300
        help
            Time between short beeps while the 15 s fall countdown runs.

    config WISENSE_EMERGENCY_LED_GPIO
        int "Emergency indicator LED GPIO"
        default 23
        help
            LED output synced with buzzer (ON/OFF with fast beeps; solid ON in alert).

    choice WISENSE_EMERGENCY_LED_ON_LEVEL
        prompt "GPIO level that turns the emergency LED ON"
        default WISENSE_EMERGENCY_LED_ON_HIGH

        config WISENSE_EMERGENCY_LED_ON_HIGH
            bool "HIGH = LED ON"

        config WISENSE_EMERGENCY_LED_ON_LOW
            bool "LOW = LED ON"
    endchoice

endmenu
```

## firmware/components/wisense_emergency_tx/Kconfig
```kconfig
menu "WiSense TX Emergency Orchestrator"

    config WISENSE_EMERGENCY_TX_TASK_STACK
        int "Orchestrator task stack (bytes)"
        default 4096
        range 2048 16384
        help
            Stack for the background emergency workflow task.

    config WISENSE_EMERGENCY_TX_TASK_PRIO
        int "Orchestrator task priority"
        default 5
        range 1 24
        help
            FreeRTOS priority. Keep below time-critical Wi-Fi work if needed.

    config WISENSE_EMERGENCY_TX_PRE_STREAM_DELAY_MS
        int "Delay after servo open before camera (ms)"
        default 2000
        range 0 60000
        help
            Short pause after opening the privacy flap so mechanics settle
            before camera/mic/stream start. Set 0 to skip.

endmenu
```

## firmware/components/wisense_espnow/Kconfig
```kconfig
menu "WiSense ESP-NOW (emergency)"

    config WISENSE_ESPNOW_WIFI_CHANNEL
        int "Wi-Fi / ESP-NOW channel"
        range 1 14
        default 11
        help
            Must match csi_send and csi_recv (default 11).

    config WISENSE_ESPNOW_TX_MAC_ADDR0
        hex "TX (ESP32-CAM) MAC byte 0"
        default 0x1A

    config WISENSE_ESPNOW_TX_MAC_ADDR1
        hex "TX (ESP32-CAM) MAC byte 1"
        default 0x00

    config WISENSE_ESPNOW_TX_MAC_ADDR2
        hex "TX (ESP32-CAM) MAC byte 2"
        default 0x00

    config WISENSE_ESPNOW_TX_MAC_ADDR3
        hex "TX (ESP32-CAM) MAC byte 3"
        default 0x00

    config WISENSE_ESPNOW_TX_MAC_ADDR4
        hex "TX (ESP32-CAM) MAC byte 4"
        default 0x00

    config WISENSE_ESPNOW_TX_MAC_ADDR5
        hex "TX (ESP32-CAM) MAC byte 5"
        default 0x00

endmenu
```

## firmware/components/wisense_fsr/Kconfig
```kconfig
menu "WiSense FSR (pressure sensor)"

    config WISENSE_FSR_GPIO
        int "FSR analog signal GPIO"
        default 34
        help
            ADC1 input for the FSR406 voltage divider (e.g. GPIO34 on ESP32 DevKit).
            GPIO32/33/34/35/36/39 are ADC1-capable on ESP32.

    config WISENSE_FSR_PRESS_THRESHOLD
        int "Raw ADC threshold to enter \"on bed\" (0-4095)"
        range 0 4095
        default 1500
        help
            Smoothed FSR reading at or above this value enters the pressed
            state. Tune with idf.py monitor while pressing the sensor.

    config WISENSE_FSR_RELEASE_THRESHOLD
        int "Raw ADC threshold to exit \"on bed\" (0-4095)"
        range 0 4095
        default 1200
        help
            Smoothed FSR reading at or below this value exits the pressed
            state. Must be lower than the press threshold — this gap
            (hysteresis) is what stops chatter for a reading that sits
            right at the boundary.

endmenu
```

## firmware/components/wisense_light/Kconfig
```kconfig
menu "WiSense Light (Relay + LDR)"

    config WISENSE_LIGHT_RELAY_GPIO
        int "Relay control GPIO"
        default 26
        help
            Signal/IN pin on the JQC3F-05VDC-C relay module.

    choice WISENSE_LIGHT_RELAY_ON_LEVEL
        prompt "GPIO level that energizes the relay"
        default WISENSE_LIGHT_RELAY_ON_HIGH
        help
            HIGH = relay ON (GPIO 1 when occupied / light on, GPIO 0 when empty).

        config WISENSE_LIGHT_RELAY_ON_LOW
            bool "LOW = relay ON"

        config WISENSE_LIGHT_RELAY_ON_HIGH
            bool "HIGH = relay ON"
    endchoice

    config WISENSE_LIGHT_LDR_GPIO
        int "LDR digital output GPIO"
        default 32
        help
            DO pin on the LDR module (digital output).

    choice WISENSE_LIGHT_LDR_DARK_LEVEL
        prompt "LDR GPIO level when the room is dark"
        default WISENSE_LIGHT_LDR_DARK_IS_HIGH
        help
            Adjust if your module inverts DO (potentiometer on the module).
            Many LM393 boards read HIGH when dark and LOW when bright.

        config WISENSE_LIGHT_LDR_DARK_IS_LOW
            bool "LOW = dark"

        config WISENSE_LIGHT_LDR_DARK_IS_HIGH
            bool "HIGH = dark"
    endchoice

    config WISENSE_LIGHT_EMPTY_OFF_SEC
        int "Seconds Empty before relay turns OFF"
        range 1 3600
        default 5
        help
            After Presence or Motion changes to Empty, turn the relay OFF
            if the room stays Empty for this many seconds.

    config WISENSE_LIGHT_LDR_POLL_MS
        int "LDR poll interval while occupied (ms)"
        range 100 10000
        default 500
        help
            While Presence or Motion is active, poll the LDR at this interval
            and turn the relay ON when the room becomes dark.

    config WISENSE_LIGHT_LDR_DEBOUNCE_MS
        int "LDR debounce sample interval (ms)"
        range 20 2000
        default 200
        help
            How often the raw LDR pin is sampled for debouncing. Runs
            continuously (not just while occupied) so wisense_light_is_dark()
            is always settled.

    config WISENSE_LIGHT_LDR_DEBOUNCE_COUNT
        int "LDR debounce — consecutive matching samples required"
        range 1 20
        default 3
        help
            The reported dark/bright state only flips after this many
            consecutive samples agree, to reject chatter right at the
            day/night threshold.

endmenu
```

## firmware/components/wisense_oled/Kconfig
```kconfig
menu "WiSense OLED (SSD1306)"

    config WISENSE_OLED_I2C_PORT
        int "I2C port number"
        range 0 1
        default 0

    config WISENSE_OLED_I2C_SDA_GPIO
        int "I2C SDA GPIO"
        default 21
        help
            Default SDA pin for ESP32 DevKit hardware bring-up.

    config WISENSE_OLED_I2C_SCL_GPIO
        int "I2C SCL GPIO"
        default 22
        help
            Default SCL pin for ESP32 DevKit hardware bring-up.

    config WISENSE_OLED_I2C_ADDR
        hex "SSD1306 I2C address"
        default 0x3C
        help
            Most 128x64 modules use 0x3C. Some use 0x3D.

    config WISENSE_OLED_I2C_FREQ_HZ
        int "I2C clock frequency (Hz)"
        default 400000

endmenu
```
